## conf/distro/poky-custom.conf
```bitbake
# This distro is based on systemd, upstream linux kernel and bootloader
include poky.conf

MAINTAINER_append = " Fabien Lahoudere <fabienlahoudere.pro@gmail.com> "

DISTRO_FEATURES_append = " systemd"
VIRTUAL-RUNTIME_init_manager = "systemd"
DISTRO_FEATURES_BACKFILL_CONSIDERED = "sysvinit"
VIRTUAL-RUNTIME_initscripts = ""

PACKAGE_CLASSES = "package_deb"

DISTRO_FEATURES_append = " wayland opengl"
DISTRO_FEATURES_remove = "x11"

# Use default root value
ROOT_HOME = "/root"
```

## conf/layer.conf
```bitbake
# We have a conf and classes directory, add to BBPATH
BBPATH .= ":${LAYERDIR}"

# We have recipes-* directories, add to BBFILES
BBFILES += "${LAYERDIR}/recipes-*/*/*.bb \
	${LAYERDIR}/recipes-*/*/*.bbappend"

BBFILE_COLLECTIONS += "meta-nas"
BBFILE_PATTERN_meta-nas = "^${LAYERDIR}/"
BBFILE_PRIORITY_meta-nas = "6"
```
